## config/boards/shields/ecorn/Kconfig.defconfig
```kconfig
# Copyright (c) 2020 The ZMK Contributors
# SPDX-License-Identifier: MIT

config ZMK_BLE
	default y

config ZMK_USB
	default y

if SHIELD_ECORN_DONGLE

config ZMK_KEYBOARD_NAME
	default "eCorn Dongle"

endif

if SHIELD_ECORN_LEFT || SHIELD_ECORN_RIGHT

config ZMK_SPLIT
	default y

endif



if SHIELD_ECORN_DONGLE 

config ZMK_SPLIT
	default y

config ZMK_SPLIT_BLE_ROLE_CENTRAL
	default y

endif
```

## config/boards/shields/ecorn/Kconfig.shield
```kconfig
# Copyright (c) 2020 The ZMK Contributors
# SPDX-License-Identifier: MIT

config SHIELD_ECORN_LEFT
	def_bool $(shields_list_contains,ecorn_left)

config SHIELD_ECORN_RIGHT
	def_bool $(shields_list_contains,ecorn_right)

config SHIELD_ECORN_DONGLE
	def_bool $(shields_list_contains,ecorn_dongle)
```

## config/west.yml
```yaml
manifest:
  remotes:
    - name: franktheficus
      url-base: https://github.com/franktheficus
  projects:
    - name: zmk
      remote: franktheficus
      revision: central-to-multiple-peripherals
      import: app/west.yml
  self:
    path: config
```
